## app/Kconfig
```kconfig
# Copyright (c) 2019 Nordic Semiconductor ASA
# SPDX-License-Identifier: Apache-2.0

mainmenu "Application"

rsource "src/version/Kconfig"

config SPI
	default y

source "Kconfig.zephyr"
```

## app/dts/bindings/trinamic/trinamic,tmc2130.yaml
```yaml
# Cpyright (c) 2019, Nordic Semiconductor ASA
# SPDX-License-Identifier: Apache-2.0

description: |
    Trinamic driver for the tmc2130
    - spi-max-frequency
    - pwms
    - gpio


compatible: "trinamic,tmc2130-spi"

include: [spi-device.yaml]

properties:
    pwms:
      required: false
      type: phandle-array
      description: |
        PWM for step signal  
    
    step-gpios:
      required: false
      type: phandle-array
      description: |
        gpio used to generate step signal 
    
    dir-gpios:
      required: false
      type: phandle-array
      description: |
        gpio used to generate dir sgnal 
    
    en-gpios:
      required: false
      type: phandle-array
      description: |
        Humman readable string describing the device
    
    label:
      required: false
      type: string
      description: |
        Humman readable string describing the device
```
