/*
 * Copyright (c) 2021, STMicroelectronics
 *
 * SPDX-License-Identifier: Apache-2.0
 */

&spi1{
    tmc1: tmc2130@0{   
            compatible = "trinamic,tmc2130-spi";
            
            /*io for the tmc2130 */
            pwms        = <&pwm1 1 1000 PWM_POLARITY_INVERTED>;
            step-gpios  = <&gpioc 13 GPIO_ACTIVE_LOW>;
            en-gpios    = <&gpioc 14 GPIO_ACTIVE_LOW>;
            dir-gpios   = <&gpioc 12 GPIO_ACTIVE_LOW>;
            
            label = "mtr1" ;
            reg = <0>;
            spi-max-frequency = <40000>;
        };
            cs-gpios= <&gpioa 4 GPIO_ACTIVE_LOW>;
            
};
